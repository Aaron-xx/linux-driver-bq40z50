// bq40z50-overlay.dts
/dts-v1/;
/plugin/;

/ {
	compatible = "brcm,bcm2835";

	fragment@0 {
		target = <&i2c1>;
		__overlay__ {
			#address-cells = <1>;
			#size-cells = <0>;
			status = "okay";

			bq40z50: bq40z50@0B {
				compatible = "ti,bq40z50";
				reg = <0x0B>;
				status = "okay";
			};
		};
	};
};
